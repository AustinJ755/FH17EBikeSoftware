/**
 * These arguments were used when this file was generated. They will be automatically applied on subsequent loads
 * via the GUI or CLI. Run CLI with '--help' for additional information on how to override these arguments.
 * @cliArgs --board "/LAUNCHXL_F280049C" --context "system" --product "C2000WARE@4.02.00.00"
 * @versions {"tool":"1.14.0+2667"}
 */

/**
 * Import the modules used in this configuration.
 */
const adc    = scripting.addModule("/driverlib/adc.js", {}, false);
const adc1   = adc.addInstance();
const adc2   = adc.addInstance();
const adc3   = adc.addInstance();
const aio    = scripting.addModule("/driverlib/aio.js", {}, false);
const aio1   = aio.addInstance();
const aio2   = aio.addInstance();
const aio3   = aio.addInstance();
const aio4   = aio.addInstance();
const aio5   = aio.addInstance();
const aio6   = aio.addInstance();
const epwm   = scripting.addModule("/driverlib/epwm.js", {}, false);
const epwm1  = epwm.addInstance();
const epwm2  = epwm.addInstance();
const epwm3  = epwm.addInstance();
const gpio   = scripting.addModule("/driverlib/gpio.js", {}, false);
const gpio1  = gpio.addInstance();
const gpio2  = gpio.addInstance();
const gpio3  = gpio.addInstance();
const gpio4  = gpio.addInstance();
const gpio5  = gpio.addInstance();
const gpio6  = gpio.addInstance();
const gpio7  = gpio.addInstance();
const gpio8  = gpio.addInstance();
const gpio9  = gpio.addInstance();
const gpio10 = gpio.addInstance();
const gpio11 = gpio.addInstance();
const gpio12 = gpio.addInstance();
const sci    = scripting.addModule("/driverlib/sci.js", {}, false);
const sci1   = sci.addInstance();
const sci2   = sci.addInstance();
const spi    = scripting.addModule("/driverlib/spi.js", {}, false);
const spi1   = spi.addInstance();
const spi2   = spi.addInstance();

/**
 * Write custom configuration values to the imported modules.
 */
adc1.$name       = "ADC_PHASE_A";
adc1.enabledSOCs = ["ADC_SOC_NUMBER0"];

adc2.$name   = "ADC_PHASE_B";
adc2.adcBase = "ADCB_BASE";

adc3.$name   = "ADC_PHASE_C";
adc3.adcBase = "ADCC_BASE";

aio1.$name                  = "PHASE_U_CURRENT_SENSOR";
aio1.aioPin["AIO#"].$assign = "boosterpack2.70";

aio2.$name                  = "PHASE_V_CURRENT_SENSOR";
aio2.aioPin["AIO#"].$assign = "boosterpack1.24";

aio3.$name                  = "PHASE_W_CURRENT_SENSOR";
aio3.aioPin["AIO#"].$assign = "boosterpack1.28";

aio4.$name                  = "THROTTLE_ADC_SENSOR";
aio4.aioPin["AIO#"].$assign = "boosterpack1.30";

aio5.$name                  = "BATTERY_VOLTAGE_SENSOR";
aio5.aioPin["AIO#"].$assign = "boosterpack1.26";

aio6.$name                  = "MOTOR_CONTROLLER_TEMP_SENSOR";
aio6.aioPin["AIO#"].$assign = "boosterpack2.66";

epwm1.$name     = "PHASE_A_EPWM";
epwm1.$hardware = system.deviceData.board.components.BP_SITE_2.subComponents.PWM_LOC1;

epwm2.$name     = "PHASE_B_EPWM";
epwm2.$hardware = system.deviceData.board.components.BP_SITE_2.subComponents.PWM_LOC3;

epwm3.$name     = "PHASE_C_EPWM";
epwm3.$hardware = system.deviceData.board.components.BP_SITE_1.subComponents.PWM_LOC3;

gpio1.direction         = "GPIO_DIR_MODE_OUT";
gpio1.writeInitialValue = true;
gpio1.initialValue      = 1;
gpio1.$name             = "ILI9341_GPIO_CS";
gpio1.gpioPin.$assign   = "boosterpack1.39";
scripting.suppress("Connected to hardware,@@@.+?@@@ is connected to EPWM6 BP on the LaunchPad F280049C\\. Consider selecting it in 'use hardware' above\\. @@@.+?@@@", gpio1, "gpioPin");

gpio2.direction         = "GPIO_DIR_MODE_OUT";
gpio2.writeInitialValue = true;
gpio2.$name             = "ILI9341_GPIO_DCX";
gpio2.gpioPin.$assign   = "boosterpack1.13";

gpio3.$name = "GPIO_BUTTON_1_GPIO";

gpio4.$name = "GPIO_BUTTON_2_GPIO";

gpio5.$name = "GPIO_BUTTON_3_GPIO";

gpio6.$name           = "GPIO_BUTTON_4_GPIO";
gpio6.gpioPin.$assign = "boosterpack2.73";
scripting.suppress("Connected to hardware,@@@.+?@@@ is connected to EQEP2 Header on the LaunchPad F280049C\\. Consider selecting it in 'use hardware' above\\. @@@.+?@@@", gpio6, "gpioPin");

gpio7.$name           = "ESTOP_BUTTON_GPIO";
gpio7.gpioPin.$assign = "boosterpack2.72";
scripting.suppress("Connected to hardware,@@@.+?@@@ is connected to EQEP2 Header on the LaunchPad F280049C\\. Consider selecting it in 'use hardware' above\\. @@@.+?@@@", gpio7, "gpioPin");

gpio8.$name           = "HALL_EFFECT_U_GPIO";
gpio8.gpioPin.$assign = "boosterpack1.10";
scripting.suppress("Connected to hardware,@@@.+?@@@ is connected to EQEP1 Header on the LaunchPad F280049C\\. Consider selecting it in 'use hardware' above\\. @@@.+?@@@", gpio8, "gpioPin");

gpio9.$name           = "HALL_EFFECT_V_GPIO";
gpio9.gpioPin.$assign = "boosterpack1.9";
scripting.suppress("Connected to hardware,@@@.+?@@@ is connected to EQEP1 Header on the LaunchPad F280049C\\. Consider selecting it in 'use hardware' above\\. @@@.+?@@@", gpio9, "gpioPin");

gpio10.$name           = "HALL_EFFECT_W_GPIO";
gpio10.gpioPin.$assign = "boosterpack1.11";
scripting.suppress("Connected to hardware,@@@.+?@@@ is connected to EQEP1 Header on the LaunchPad F280049C\\. Consider selecting it in 'use hardware' above\\. @@@.+?@@@", gpio10, "gpioPin");

gpio11.$name           = "PEDAL_ASSIST_SENSOR";
gpio11.gpioPin.$assign = "boosterpack2.74";
scripting.suppress("Connected to hardware,@@@.+?@@@ is connected to EQEP2 Header on the LaunchPad F280049C\\. Consider selecting it in 'use hardware' above\\. @@@.+?@@@", gpio11, "gpioPin");

gpio12.$name           = "MOTOR_CONTROL_FAULT_PIN";
gpio12.gpioPin.$assign = "boosterpack2.51";
scripting.suppress("Connected to hardware,@@@.+?@@@ is connected to FSI Header on the LaunchPad F280049C\\. Consider selecting it in 'use hardware' above\\. @@@.+?@@@", gpio12, "gpioPin");

sci1.$hardware             = system.deviceData.board.components.XDS_UART.subComponents.XDS_SCI_INST1;
sci1.enabledFIFOInterrupts = ["SCI_INT_RXFF"];
sci1.rxFifo                = "SCI_FIFO_RX1";
sci1.$name                 = "DATA_LOG_UART";

sci2.$name     = "GPS_COM_UART";
sci2.$hardware = system.deviceData.board.components.BP_SITE_1.subComponents.SCI;

spi1.$name                           = "Ili9341_SPI";
spi1.emulationMode                   = "SPI_EMULATION_STOP_AFTER_TRANSMIT";
spi1.useDMATX                        = true;
spi1.mode                            = "SPI_MODE_MASTER";
spi1.$hardware                       = system.deviceData.board.components.BP_SITE_1.subComponents.SPI;
spi1.rxFifo                          = "SPI_FIFO_RX8";
spi1.transferProtocol                = "SPI_PROT_POL0PHA1";
spi1.enabledFIFOInterrupts           = ["SPI_INT_RXFF","SPI_INT_TXFF"];
spi1.txFifo                          = "SPI_FIFO_TX0";
spi1.bitRate                         = 25000000;
spi1.spiTXDMA.databusWidthConfig     = scripting.forceWrite("DMA_CFG_SIZE_16BIT");
spi1.spiTXDMA.enableTriggers         = true;
spi1.spiTXDMA.useInterrupts          = true;
spi1.spiTXDMA.registerInterrupts     = true;
spi1.spiTXDMA.enableInterrupts       = true;
spi1.spiTXDMA.interruptMode          = "DMA_INT_AT_END";
spi1.spiTXDMA.transferSize           = 16;
spi1.spiTXDMA.srcAddressInputMode    = "VARIABLE";
spi1.spiTXDMA.srcBurstStep           = 1;
spi1.spiTXDMA.srcTransferStep        = 1;
spi1.spiTXDMA.srcAddressVariable     = "ili9341_dma_src_address";
spi1.spiTXDMA.burstSize              = 8;
spi1.spiTXDMA.dmaInt.enableInterrupt = true;
spi1.spi.$assign                     = "SPIA";

spi2.$hardware = system.deviceData.board.components.BP_SITE_2.subComponents.SPI;
spi2.$name     = "SD_CARD_SPI";

/**
 * Pinmux solution for unlocked pins/peripherals. This ensures that minor changes to the automatic solver in a future
 * version of the tool will not impact the pinmux you originally saw.  These lines can be completely deleted in order to
 * re-solve from scratch.
 */
aio1.aioPin.$suggestSolution          = "AIO231";
aio2.aioPin.$suggestSolution          = "AIO241";
aio3.aioPin.$suggestSolution          = "AIO237";
aio4.aioPin.$suggestSolution          = "AIO232";
aio5.aioPin.$suggestSolution          = "AIO230";
aio6.aioPin.$suggestSolution          = "AIO238";
epwm1.epwm.$suggestSolution           = "EPWM1";
epwm1.epwm.epwm_aPin.$suggestSolution = "boosterpack2.80";
epwm1.epwm.epwm_bPin.$suggestSolution = "boosterpack2.79";
epwm2.epwm.$suggestSolution           = "EPWM2";
epwm2.epwm.epwm_aPin.$suggestSolution = "boosterpack2.76";
epwm2.epwm.epwm_bPin.$suggestSolution = "boosterpack2.75";
epwm3.epwm.$suggestSolution           = "EPWM3";
epwm3.epwm.epwm_aPin.$suggestSolution = "boosterpack1.36";
epwm3.epwm.epwm_bPin.$suggestSolution = "boosterpack1.35";
gpio3.gpioPin.$suggestSolution        = "boosterpack1.34";
gpio4.gpioPin.$suggestSolution        = "boosterpack1.32";
gpio5.gpioPin.$suggestSolution        = "boosterpack1.33";
sci1.sci.$suggestSolution             = "SCIA";
sci1.sci.sci_rxPin.$suggestSolution   = "boosterpack2.43";
sci1.sci.sci_txPin.$suggestSolution   = "boosterpack2.44";
sci2.sci.$suggestSolution             = "SCIB";
sci2.sci.sci_rxPin.$suggestSolution   = "boosterpack1.3";
sci2.sci.sci_txPin.$suggestSolution   = "boosterpack1.4";
spi1.spi.spi_simoPin.$suggestSolution = "boosterpack1.15";
spi1.spi.spi_somiPin.$suggestSolution = "boosterpack1.14";
spi1.spi.spi_clkPin.$suggestSolution  = "boosterpack1.7";
spi1.spi.spi_stePin.$suggestSolution  = "boosterpack1.19";
spi2.spi.$suggestSolution             = "SPIB";
spi2.spi.spi_simoPin.$suggestSolution = "boosterpack2.55";
spi2.spi.spi_somiPin.$suggestSolution = "boosterpack2.54";
spi2.spi.spi_clkPin.$suggestSolution  = "boosterpack2.47";
spi2.spi.spi_stePin.$suggestSolution  = "boosterpack2.59";
