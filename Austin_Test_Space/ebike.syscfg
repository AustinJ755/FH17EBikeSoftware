/**
 * @cliArgs --board "/LAUNCHXL_F280049C" --context "system" --product "C2000WARE@4.02.00.00"
 * @versions {"tool":"1.14.0+2667"}
 */

/**
 * Import the modules used in this configuration.
 */
const adc              = scripting.addModule("/driverlib/adc.js", {}, false);
const adc1             = adc.addInstance();
const adc2             = adc.addInstance();
const adc3             = adc.addInstance();
const aio              = scripting.addModule("/driverlib/aio.js", {}, false);
const aio1             = aio.addInstance();
const aio2             = aio.addInstance();
const aio3             = aio.addInstance();
const aio4             = aio.addInstance();
const aio5             = aio.addInstance();
const aio6             = aio.addInstance();
const asysctl          = scripting.addModule("/driverlib/asysctl.js");
const cputimer         = scripting.addModule("/driverlib/cputimer.js", {}, false);
const cputimer1        = cputimer.addInstance();
const cputimer2        = cputimer.addInstance();
const ecap             = scripting.addModule("/driverlib/ecap.js", {}, false);
const ecap1            = ecap.addInstance();
const ecap2            = ecap.addInstance();
const ecap3            = ecap.addInstance();
const epwm             = scripting.addModule("/driverlib/epwm.js");
const epwm1            = epwm.addInstance();
const epwm2            = epwm.addInstance();
const epwm3            = epwm.addInstance();
const gpio             = scripting.addModule("/driverlib/gpio.js", {}, false);
const gpio1            = gpio.addInstance();
const gpio2            = gpio.addInstance();
const gpio3            = gpio.addInstance();
const gpio4            = gpio.addInstance();
const gpio5            = gpio.addInstance();
const gpio6            = gpio.addInstance();
const gpio7            = gpio.addInstance();
const gpio8            = gpio.addInstance();
const gpio9            = gpio.addInstance();
const gpio10           = gpio.addInstance();
const gpio11           = gpio.addInstance();
const gpio12           = gpio.addInstance();
const gpio13           = gpio.addInstance();
const gpio14           = gpio.addInstance();
const inputxbar_input  = scripting.addModule("/driverlib/inputxbar_input.js", {}, false);
const inputxbar_input1 = inputxbar_input.addInstance();
const inputxbar_input2 = inputxbar_input.addInstance();
const inputxbar_input3 = inputxbar_input.addInstance();
const inputxbar_input4 = inputxbar_input.addInstance();
const inputxbar_input5 = inputxbar_input.addInstance();
const inputxbar_input6 = inputxbar_input.addInstance();
const inputxbar_input7 = inputxbar_input.addInstance();
const sci              = scripting.addModule("/driverlib/sci.js", {}, false);
const sci1             = sci.addInstance();
const sci2             = sci.addInstance();
const spi              = scripting.addModule("/driverlib/spi.js", {}, false);
const spi1             = spi.addInstance();
const spi2             = spi.addInstance();
const sync             = scripting.addModule("/driverlib/sync.js");
const sysctl           = scripting.addModule("/driverlib/sysctl.js");

/**
 * Write custom configuration values to the imported modules.
 */
adc1.socHighPriorityMode         = "ADC_PRI_SOC0_HIPRI";
adc1.soc0Trigger                 = "ADC_TRIGGER_EPWM1_SOCA";
adc1.soc1Channel                 = "ADC_CH_ADCIN1";
adc1.$name                       = "ADC_A";
adc1.soc0Name                    = "PHASE_U_CURR_SAMPLE";
adc1.soc1Name                    = "THROTTLE_SAMPLE";
adc1.interruptPulseMode          = "ADC_PULSE_END_OF_CONV";
adc1.enabledInts                 = ["ADC_INT_NUMBER1"];
adc1.enableInterrupt1            = true;
adc1.registerInterrupts          = ["1"];
adc1.soc0UseSampleTimeCalculator = true;
adc1.soc0InputCapacitance        = 5;
adc1.soc0InputResistance         = 100;
adc1.soc0SampleWindow            = 4;
adc1.soc1SampleWindow            = 50;
adc1.enabledSOCs                 = ["ADC_SOC_NUMBER0","ADC_SOC_NUMBER1"];
adc1.soc1Trigger                 = "ADC_TRIGGER_EPWM1_SOCA";
adc1.adcInt1.enableInterrupt     = true;
adc1.adcInt1.interruptHandler    = "pwmCountTrigger";

adc2.adcBase              = "ADCB_BASE";
adc2.$name                = "ADC_B";
adc2.socHighPriorityMode  = "ADC_PRI_SOC0_HIPRI";
adc2.enabledSOCs          = ["ADC_SOC_NUMBER0","ADC_SOC_NUMBER1"];
adc2.soc0Name             = "PHASE_CUR_SAMPLE";
adc2.soc0Trigger          = "ADC_TRIGGER_EPWM1_SOCA";
adc2.soc1Name             = "BATTERY_VOLTAGE_SAMPLE";
adc2.soc1Channel          = "ADC_CH_ADCIN1";
adc2.useInterrupts        = false;
adc2.soc0SampleWindow     = 4;
adc2.soc1InterruptTrigger = "ADC_INT_SOC_TRIGGER_ADCINT1";
adc2.soc1SampleWindow     = 50;

adc3.adcBase              = "ADCC_BASE";
adc3.$name                = "ADC_C";
adc3.socHighPriorityMode  = "ADC_PRI_SOC0_HIPRI";
adc3.enabledSOCs          = ["ADC_SOC_NUMBER0","ADC_SOC_NUMBER1"];
adc3.soc0Name             = "PHASE_W_CURR_SAMPLE";
adc3.soc0Trigger          = "ADC_TRIGGER_EPWM1_SOCA";
adc3.soc1Name             = "MOTOR_CONTROL_TEMP_SENSE";
adc3.soc1Channel          = "ADC_CH_ADCIN1";
adc3.useInterrupts        = false;
adc3.soc0SampleWindow     = 4;
adc3.soc1InterruptTrigger = "ADC_INT_SOC_TRIGGER_ADCINT1";
adc3.soc1SampleWindow     = 50;

aio1.$name                  = "PHASE_U_CURRENT_SENSOR";
aio1.aioPin["AIO#"].$assign = "boosterpack2.70";

aio2.$name                  = "PHASE_V_CURRENT_SENSOR";
aio2.aioPin["AIO#"].$assign = "boosterpack1.24";

aio3.$name                  = "PHASE_W_CURRENT_SENSOR";
aio3.aioPin["AIO#"].$assign = "boosterpack1.28";

aio4.$name                  = "THROTTLE_ADC_SENSOR";
aio4.aioPin["AIO#"].$assign = "boosterpack1.30";

aio5.$name                  = "BATTERY_VOLTAGE_SENSOR";
aio5.aioPin["AIO#"].$assign = "boosterpack1.26";

aio6.$name                  = "MOTOR_CONTROLLER_TEMP_SENSOR";
aio6.aioPin["AIO#"].$assign = "boosterpack2.66";

asysctl.analogReference        = "INTERNAL";
asysctl.analogReferenceVoltage = "1P65";

cputimer1.$name                     = "myCPUTIMER0";
cputimer1.startTimer                = true;
cputimer1.timerPeriod               = 4294967295;
cputimer1.timerPrescaler            = 4;
cputimer1.enableInterrupt           = true;
cputimer1.registerInterrupts        = true;
cputimer1.timerInt.enableInterrupt  = true;
cputimer1.timerInt.interruptHandler = "timer0ISR";

cputimer2.$name                     = "myCPUTIMER1";
cputimer2.cputimerBase              = "CPUTIMER1_BASE";
cputimer2.timerPeriod               = 100000000;
cputimer2.enableInterrupt           = true;
cputimer2.registerInterrupts        = true;
cputimer2.startTimer                = true;
cputimer2.timerInt.enableInterrupt  = true;
cputimer2.timerInt.interruptHandler = "timer1ISR";

ecap1.ecapInput                = "ECAP_INPUT_INPUTXBAR1";
ecap1.$name                    = "ECAP_PHASEU";
ecap1.counterResetOnEvent      = ["ECAP_EVENT_1"];
ecap1.registerInterrupts       = true;
ecap1.enableInterrupt          = true;
ecap1.resetCounters            = true;
ecap1.interruptSourceCapture   = ["ECAP_ISR_SOURCE_CAPTURE_EVENT_1"];
ecap1.ecapInt.interruptHandler = "directionCheck";
ecap1.ecapInt.enableInterrupt  = true;

ecap2.ecapBase            = "ECAP2_BASE";
ecap2.ecapInput           = "ECAP_INPUT_INPUTXBAR2";
ecap2.$name               = "ECAP_PHASEV";
ecap2.useInterrupts       = false;
ecap2.counterResetOnEvent = ["ECAP_EVENT_1"];

ecap3.ecapBase            = "ECAP3_BASE";
ecap3.ecapInput           = "ECAP_INPUT_INPUTXBAR3";
ecap3.$name               = "ECAP_PHASEW";
ecap3.useInterrupts       = false;
ecap3.counterResetOnEvent = ["ECAP_EVENT_1"];

epwm.enableInfo            = true;
epwm.enableWarning         = true;
epwm.generateInitFunctions = true;

epwm1.epwmDeadband_polarityFED                                   = "EPWM_DB_POLARITY_ACTIVE_LOW";
epwm1.epwmDeadband_enableFED                                     = true;
epwm1.$name                                                      = "PHASE_A_EPWM";
epwm1.$hardware                                                  = system.deviceData.board.components.BP_SITE_2.subComponents.PWM_LOC1;
epwm1.epwmEventTrigger_enableInterrupt                           = true;
epwm1.epwmEventTrigger_interruptSource                           = "EPWM_INT_TBCTR_ZERO_OR_PERIOD";
epwm1.epwmTimebase_hsClockDiv                                    = "EPWM_HSCLOCK_DIVIDER_1";
epwm1.epwmTimebase_syncOutPulseMode                              = "EPWM_SYNC_OUT_PULSE_ON_COUNTER_ZERO";
epwm1.epwmActionQualifier_EPWM_AQ_OUTPUT_A_gld                   = true;
epwm1.epwmActionQualifier_EPWM_AQ_OUTPUT_A_shadowMode            = true;
epwm1.epwmActionQualifier_EPWM_AQ_OUTPUT_B_gld                   = true;
epwm1.epwmActionQualifier_EPWM_AQ_OUTPUT_B_shadowMode            = true;
epwm1.epwmCounterCompare_cmpAGld                                 = true;
epwm1.epwmCounterCompare_cmpBGld                                 = true;
epwm1.epwmCounterCompare_cmpB                                    = 2500;
epwm1.epwmDeadband_delayRED                                      = 300;
epwm1.epwmDeadband_enableRED                                     = true;
epwm1.epwmDeadband_delayFED                                      = 300;
epwm1.epwmActionQualifier_EPWM_AQ_OUTPUT_A_onetimeSwForceAction  = "EPWM_AQ_OUTPUT_LOW";
epwm1.epwmActionQualifier_EPWM_AQ_OUTPUT_B_onetimeSwForceAction  = "EPWM_AQ_OUTPUT_LOW";
epwm1.epwmTimebase_counterMode                                   = "EPWM_COUNTER_MODE_UP_DOWN";
epwm1.epwmEventTrigger_EPWM_SOC_A_triggerEnable                  = true;
epwm1.epwmEventTrigger_EPWM_SOC_A_triggerSource                  = "EPWM_SOC_TBCTR_ZERO_OR_PERIOD";
epwm1.epwmEventTrigger_EPWM_SOC_A_triggerEventPrescalar          = "1";
epwm1.epwmEventTrigger_interruptEventCount                       = "1";
epwm1.epwmActionQualifier_EPWM_AQ_OUTPUT_B_shadowEvent           = "EPWM_AQ_LOAD_ON_CNTR_ZERO_PERIOD";
epwm1.epwmActionQualifier_EPWM_AQ_OUTPUT_A_shadowEvent           = "EPWM_AQ_LOAD_ON_CNTR_ZERO_PERIOD";
epwm1.hrpwm_syncSource                                           = "HRPWM_PWMSYNC_SOURCE_ZERO";
epwm1.epwmTimebase_periodGld                                     = true;
epwm1.epwmCounterCompare_cmpA                                    = 2000;
epwm1.epwmTimebase_period                                        = 5000;
epwm1.epwmActionQualifier_EPWM_AQ_OUTPUT_A_ON_TIMEBASE_UP_CMPA   = "EPWM_AQ_OUTPUT_LOW";
epwm1.epwmActionQualifier_EPWM_AQ_OUTPUT_A_ON_TIMEBASE_DOWN_CMPA = "EPWM_AQ_OUTPUT_HIGH";
epwm1.epwmActionQualifier_EPWM_AQ_OUTPUT_B_ON_TIMEBASE_UP_CMPA   = "EPWM_AQ_OUTPUT_HIGH";
epwm1.epwmActionQualifier_EPWM_AQ_OUTPUT_B_ON_TIMEBASE_DOWN_CMPA = "EPWM_AQ_OUTPUT_LOW";

epwm2.epwmDeadband_polarityFED                                   = "EPWM_DB_POLARITY_ACTIVE_LOW";
epwm2.epwmDeadband_enableRED                                     = true;
epwm2.epwmDeadband_enableFED                                     = true;
epwm2.$name                                                      = "PHASE_B_EPWM";
epwm2.$hardware                                                  = system.deviceData.board.components.BP_SITE_2.subComponents.PWM_LOC3;
epwm2.epwmTimebase_hsClockDiv                                    = "EPWM_HSCLOCK_DIVIDER_1";
epwm2.epwmTimebase_syncOutPulseMode                              = "EPWM_SYNC_OUT_PULSE_ON_COUNTER_ZERO";
epwm2.hrpwm_syncSource                                           = "HRPWM_PWMSYNC_SOURCE_ZERO";
epwm2.epwmCounterCompare_cmpB                                    = 2500;
epwm2.epwmCounterCompare_cmpAGld                                 = true;
epwm2.epwmCounterCompare_cmpBGld                                 = true;
epwm2.epwmCounterCompare_cmpBLink                                = "EPWM_LINK_WITH_EPWM_1";
epwm2.epwmCounterCompare_cmpALink                                = "EPWM_LINK_WITH_EPWM_1";
epwm2.epwmActionQualifier_EPWM_AQ_OUTPUT_A_gld                   = true;
epwm2.epwmActionQualifier_EPWM_AQ_OUTPUT_A_shadowMode            = true;
epwm2.epwmActionQualifier_EPWM_AQ_OUTPUT_B_gld                   = true;
epwm2.epwmActionQualifier_EPWM_AQ_OUTPUT_B_shadowMode            = true;
epwm2.epwmDeadband_delayRED                                      = 300;
epwm2.epwmDeadband_delayFED                                      = 300;
epwm2.epwmCounterCompare_cmpA                                    = 1000;
epwm2.epwmActionQualifier_EPWM_AQ_OUTPUT_A_onetimeSwForceAction  = "EPWM_AQ_OUTPUT_LOW";
epwm2.epwmActionQualifier_EPWM_AQ_OUTPUT_B_onetimeSwForceAction  = "EPWM_AQ_OUTPUT_LOW";
epwm2.epwmTimebase_counterMode                                   = "EPWM_COUNTER_MODE_UP_DOWN";
epwm2.epwmTimebase_periodLink                                    = "EPWM_LINK_WITH_EPWM_1";
epwm2.epwmTimebase_periodGld                                     = true;
epwm2.epwmTimebase_period                                        = 5000;
epwm2.epwmActionQualifier_EPWM_AQ_OUTPUT_A_ON_TIMEBASE_UP_CMPA   = "EPWM_AQ_OUTPUT_LOW";
epwm2.epwmActionQualifier_EPWM_AQ_OUTPUT_A_ON_TIMEBASE_DOWN_CMPA = "EPWM_AQ_OUTPUT_HIGH";
epwm2.epwmActionQualifier_EPWM_AQ_OUTPUT_B_ON_TIMEBASE_UP_CMPA   = "EPWM_AQ_OUTPUT_HIGH";
epwm2.epwmActionQualifier_EPWM_AQ_OUTPUT_B_ON_TIMEBASE_DOWN_CMPA = "EPWM_AQ_OUTPUT_LOW";
epwm2.epwmActionQualifier_EPWM_AQ_OUTPUT_A_shadowEvent           = "EPWM_AQ_LOAD_ON_CNTR_ZERO_PERIOD";
epwm2.epwmActionQualifier_EPWM_AQ_OUTPUT_B_shadowEvent           = "EPWM_AQ_LOAD_ON_CNTR_ZERO_PERIOD";

epwm3.epwmDeadband_polarityFED                                   = "EPWM_DB_POLARITY_ACTIVE_LOW";
epwm3.epwmDeadband_enableRED                                     = true;
epwm3.epwmDeadband_enableFED                                     = true;
epwm3.$name                                                      = "PHASE_C_EPWM";
epwm3.$hardware                                                  = system.deviceData.board.components.BP_SITE_1.subComponents.PWM_LOC3;
epwm3.epwmTimebase_hsClockDiv                                    = "EPWM_HSCLOCK_DIVIDER_1";
epwm3.epwmTimebase_syncOutPulseMode                              = "EPWM_SYNC_OUT_PULSE_ON_COUNTER_ZERO";
epwm3.hrpwm_syncSource                                           = "HRPWM_PWMSYNC_SOURCE_ZERO";
epwm3.epwmActionQualifier_EPWM_AQ_OUTPUT_A_shadowMode            = true;
epwm3.epwmActionQualifier_EPWM_AQ_OUTPUT_A_gld                   = true;
epwm3.epwmActionQualifier_continousSwForceReloadMode             = "EPWM_AQ_SW_SH_LOAD_ON_CNTR_ZERO_PERIOD";
epwm3.epwmActionQualifier_EPWM_AQ_OUTPUT_B_gld                   = true;
epwm3.epwmActionQualifier_EPWM_AQ_OUTPUT_B_shadowMode            = true;
epwm3.epwmCounterCompare_cmpBGld                                 = true;
epwm3.epwmCounterCompare_cmpB                                    = 2500;
epwm3.epwmCounterCompare_cmpAGld                                 = true;
epwm3.epwmCounterCompare_cmpALink                                = "EPWM_LINK_WITH_EPWM_1";
epwm3.epwmCounterCompare_cmpBLink                                = "EPWM_LINK_WITH_EPWM_1";
epwm3.epwmDeadband_delayRED                                      = 300;
epwm3.epwmDeadband_delayFED                                      = 300;
epwm3.epwmCounterCompare_cmpA                                    = 1000;
epwm3.epwmActionQualifier_EPWM_AQ_OUTPUT_A_onetimeSwForceAction  = "EPWM_AQ_OUTPUT_LOW";
epwm3.epwmActionQualifier_EPWM_AQ_OUTPUT_B_onetimeSwForceAction  = "EPWM_AQ_OUTPUT_LOW";
epwm3.epwmTimebase_counterMode                                   = "EPWM_COUNTER_MODE_UP_DOWN";
epwm3.epwmCounterCompare_shadowLoadModeCMPA                      = "EPWM_COMP_LOAD_ON_CNTR_ZERO_PERIOD";
epwm3.epwmTimebase_periodLink                                    = "EPWM_LINK_WITH_EPWM_1";
epwm3.epwmTimebase_periodGld                                     = true;
epwm3.epwmTimebase_period                                        = 5000;
epwm3.epwmActionQualifier_EPWM_AQ_OUTPUT_A_ON_TIMEBASE_UP_CMPA   = "EPWM_AQ_OUTPUT_LOW";
epwm3.epwmActionQualifier_EPWM_AQ_OUTPUT_A_ON_TIMEBASE_DOWN_CMPA = "EPWM_AQ_OUTPUT_HIGH";
epwm3.epwmActionQualifier_EPWM_AQ_OUTPUT_B_ON_TIMEBASE_UP_CMPA   = "EPWM_AQ_OUTPUT_HIGH";
epwm3.epwmActionQualifier_EPWM_AQ_OUTPUT_B_ON_TIMEBASE_DOWN_CMPA = "EPWM_AQ_OUTPUT_LOW";
epwm3.epwmActionQualifier_EPWM_AQ_OUTPUT_A_shadowEvent           = "EPWM_AQ_LOAD_ON_CNTR_ZERO_PERIOD";
epwm3.epwmActionQualifier_EPWM_AQ_OUTPUT_B_shadowEvent           = "EPWM_AQ_LOAD_ON_CNTR_ZERO_PERIOD";

gpio1.direction         = "GPIO_DIR_MODE_OUT";
gpio1.writeInitialValue = true;
gpio1.initialValue      = 1;
gpio1.$name             = "ILI9341_GPIO_CS";
gpio1.gpioPin.$assign   = "boosterpack1.39";
scripting.suppress("Connected to hardware,@@@.+?@@@ is connected to EPWM6 BP on the LaunchPad F280049C\\. Consider selecting it in 'use hardware' above\\. @@@.+?@@@", gpio1, "gpioPin");

gpio2.direction         = "GPIO_DIR_MODE_OUT";
gpio2.writeInitialValue = true;
gpio2.$name             = "ILI9341_GPIO_DCX";
gpio2.gpioPin.$assign   = "boosterpack1.13";

gpio3.$name    = "GPIO_BUTTON_1_GPIO";
gpio3.qualMode = "GPIO_QUAL_6SAMPLE";

gpio4.$name = "GPIO_BUTTON_2_GPIO";

gpio5.$name = "GPIO_BUTTON_3_GPIO";

gpio6.$name           = "GPIO_BUTTON_4_GPIO";
gpio6.gpioPin.$assign = "boosterpack2.73";
scripting.suppress("Connected to hardware,@@@.+?@@@ is connected to EQEP2 Header on the LaunchPad F280049C\\. Consider selecting it in 'use hardware' above\\. @@@.+?@@@", gpio6, "gpioPin");

gpio7.$name           = "ESTOP_BUTTON_GPIO";
gpio7.gpioPin.$assign = "boosterpack2.72";
scripting.suppress("Connected to hardware,@@@.+?@@@ is connected to EQEP2 Header on the LaunchPad F280049C\\. Consider selecting it in 'use hardware' above\\. @@@.+?@@@", gpio7, "gpioPin");

gpio8.$name                      = "HALL_EFFECT_U_GPIO";
gpio8.useInterrupt               = true;
gpio8.qualMode                   = "GPIO_QUAL_6SAMPLE";
gpio8.gpioPin.$assign            = "boosterpack1.10";
gpio8.xint.enableInt             = true;
gpio8.xint.registerInterrupts    = true;
gpio8.xint.xInt.enableInterrupt  = true;
gpio8.xint.xInt.interruptHandler = "logTime";
scripting.suppress("Connected to hardware,@@@.+?@@@ is connected to EQEP1 Header on the LaunchPad F280049C\\. Consider selecting it in 'use hardware' above\\. @@@.+?@@@", gpio8, "gpioPin");

gpio9.$name                      = "HALL_EFFECT_V_GPIO";
gpio9.useInterrupt               = true;
gpio9.qualMode                   = "GPIO_QUAL_6SAMPLE";
gpio9.gpioPin.$assign            = "boosterpack1.9";
gpio9.xint.xintNum               = "GPIO_INT_XINT2";
gpio9.xint.intType               = "GPIO_INT_TYPE_BOTH_EDGES";
gpio9.xint.enableInt             = true;
gpio9.xint.registerInterrupts    = true;
gpio9.xint.xInt.enableInterrupt  = true;
gpio9.xint.xInt.interruptHandler = "logTime1";
scripting.suppress("Connected to hardware,@@@.+?@@@ is connected to EQEP1 Header on the LaunchPad F280049C\\. Consider selecting it in 'use hardware' above\\. @@@.+?@@@", gpio9, "gpioPin");

gpio10.$name                      = "HALL_EFFECT_W_GPIO";
gpio10.useInterrupt               = true;
gpio10.qualMode                   = "GPIO_QUAL_6SAMPLE";
gpio10.gpioPin.$assign            = "boosterpack1.11";
gpio10.xint.intType               = "GPIO_INT_TYPE_BOTH_EDGES";
gpio10.xint.enableInt             = true;
gpio10.xint.registerInterrupts    = true;
gpio10.xint.xintNum               = "GPIO_INT_XINT3";
gpio10.xint.xInt.enableInterrupt  = true;
gpio10.xint.xInt.interruptHandler = "logTime2";
scripting.suppress("Connected to hardware,@@@.+?@@@ is connected to EQEP1 Header on the LaunchPad F280049C\\. Consider selecting it in 'use hardware' above\\. @@@.+?@@@", gpio10, "gpioPin");

gpio11.$name           = "PEDAL_ASSIST_SENSOR";
gpio11.gpioPin.$assign = "boosterpack2.74";
scripting.suppress("Connected to hardware,@@@.+?@@@ is connected to EQEP2 Header on the LaunchPad F280049C\\. Consider selecting it in 'use hardware' above\\. @@@.+?@@@", gpio11, "gpioPin");

gpio12.$name           = "MOTOR_CONTROL_FAULT_PIN";
gpio12.gpioPin.$assign = "boosterpack2.51";
scripting.suppress("Connected to hardware,@@@.+?@@@ is connected to FSI Header on the LaunchPad F280049C\\. Consider selecting it in 'use hardware' above\\. @@@.+?@@@", gpio12, "gpioPin");

gpio13.$name             = "ILI9341_GPIO_RESET_PIN";
gpio13.direction         = "GPIO_DIR_MODE_OUT";
gpio13.writeInitialValue = true;
gpio13.initialValue      = 1;
gpio13.gpioPin.$assign   = "boosterpack1.40";
scripting.suppress("Connected to hardware,@@@.+?@@@ is connected to EPWM6 BP on the LaunchPad F280049C\\. Consider selecting it in 'use hardware' above\\. @@@.+?@@@", gpio13, "gpioPin");

gpio14.$name           = "MotorEnableINV";
gpio14.padConfig       = "PULLUP";
gpio14.qualMode        = "GPIO_QUAL_3SAMPLE";
gpio14.gpioPin.$assign = "boosterpack1.38";
scripting.suppress("Connected to hardware,@@@.+?@@@ is connected to EPWM5 BP on the LaunchPad F280049C\\. Consider selecting it in 'use hardware' above\\. @@@.+?@@@", gpio14, "gpioPin");

inputxbar_input1.inputxbarGpio = "GPIO35";
inputxbar_input1.$name         = "PhaseUHall";

inputxbar_input2.inputxbarInput = "XBAR_INPUT2";
inputxbar_input2.inputxbarGpio  = "GPIO37";
inputxbar_input2.$name          = "PhaseVHall";

inputxbar_input3.inputxbarInput = "XBAR_INPUT3";
inputxbar_input3.inputxbarGpio  = "GPIO59";
inputxbar_input3.$name          = "PhaseWHall";

inputxbar_input4.$name         = "myINPUTXBARINPUT0";
gpio8.xint.inputxbar           = inputxbar_input4;
inputxbar_input4.inputxbarGpio = "GPIO35";

inputxbar_input5.$name         = "myINPUTXBARINPUT1";
gpio9.xint.inputxbar           = inputxbar_input5;
inputxbar_input5.inputxbarGpio = "GPIO37";

inputxbar_input6.$name         = "myINPUTXBARINPUT2";
gpio10.xint.inputxbar          = inputxbar_input6;
inputxbar_input6.inputxbarGpio = "GPIO59";

inputxbar_input7.$name          = "myINPUTXBARINPUT3";
inputxbar_input7.inputxbarInput = "XBAR_INPUT13";
inputxbar_input7.inputxbarGpio  = "GPIO58";

sci1.$hardware             = system.deviceData.board.components.XDS_UART.subComponents.XDS_SCI_INST1;
sci1.enabledFIFOInterrupts = ["SCI_INT_RXFF"];
sci1.rxFifo                = "SCI_FIFO_RX1";
sci1.$name                 = "DATA_LOG_UART";

sci2.$name     = "GPS_COM_UART";
sci2.$hardware = system.deviceData.board.components.BP_SITE_1.subComponents.SCI;

spi1.$name                           = "Ili9341_SPI";
spi1.emulationMode                   = "SPI_EMULATION_STOP_AFTER_TRANSMIT";
spi1.useDMATX                        = true;
spi1.mode                            = "SPI_MODE_MASTER";
spi1.$hardware                       = system.deviceData.board.components.BP_SITE_1.subComponents.SPI;
spi1.rxFifo                          = "SPI_FIFO_RX8";
spi1.transferProtocol                = "SPI_PROT_POL0PHA1";
spi1.enabledFIFOInterrupts           = ["SPI_INT_RXFF","SPI_INT_TXFF"];
spi1.txFifo                          = "SPI_FIFO_TX0";
spi1.bitRate                         = 25000000;
spi1.spiTXDMA.databusWidthConfig     = scripting.forceWrite("DMA_CFG_SIZE_16BIT");
spi1.spiTXDMA.enableTriggers         = true;
spi1.spiTXDMA.useInterrupts          = true;
spi1.spiTXDMA.registerInterrupts     = true;
spi1.spiTXDMA.enableInterrupts       = true;
spi1.spiTXDMA.interruptMode          = "DMA_INT_AT_END";
spi1.spiTXDMA.transferSize           = 16;
spi1.spiTXDMA.srcAddressInputMode    = "VARIABLE";
spi1.spiTXDMA.srcBurstStep           = 1;
spi1.spiTXDMA.srcTransferStep        = 1;
spi1.spiTXDMA.srcAddressVariable     = "ili9341_dma_src_address";
spi1.spiTXDMA.burstSize              = 8;
spi1.spiTXDMA.dmaInt.enableInterrupt = true;
spi1.spi.$assign                     = "SPIA";

spi2.$hardware = system.deviceData.board.components.BP_SITE_2.subComponents.SPI;
spi2.$name     = "SD_CARD_SPI";
spi2.bitRate   = 25000000;

sysctl.enable_SYSCTL_PERIPH_CLK_EPWM4     = false;
sysctl.enable_SYSCTL_PERIPH_CLK_EPWM5     = false;
sysctl.enable_SYSCTL_PERIPH_CLK_EPWM6     = false;
sysctl.enable_SYSCTL_PERIPH_CLK_EPWM7     = false;
sysctl.enable_SYSCTL_PERIPH_CLK_EPWM8     = false;
sysctl.enable_SYSCTL_PERIPH_CLK_EQEP1     = false;
sysctl.enable_SYSCTL_PERIPH_CLK_EQEP2     = false;
sysctl.enable_SYSCTL_PERIPH_CLK_CANA      = false;
sysctl.enable_SYSCTL_PERIPH_CLK_CANB      = false;
sysctl.enable_SYSCTL_PERIPH_CLK_PGA1      = false;
sysctl.enable_SYSCTL_PERIPH_CLK_PGA2      = false;
sysctl.enable_SYSCTL_PERIPH_CLK_PGA3      = false;
sysctl.enable_SYSCTL_PERIPH_CLK_PGA4      = false;
sysctl.enable_SYSCTL_PERIPH_CLK_PGA5      = false;
sysctl.enable_SYSCTL_PERIPH_CLK_PGA6      = false;
sysctl.enable_SYSCTL_PERIPH_CLK_PGA7      = false;
sysctl.enable_SYSCTL_PERIPH_CLK_TBCLKSYNC = true;
sysctl.enable_SYSCTL_PERIPH_CLK_CLB1      = false;
sysctl.enable_SYSCTL_PERIPH_CLK_CLB2      = false;
sysctl.enable_SYSCTL_PERIPH_CLK_CLB3      = false;
sysctl.enable_SYSCTL_PERIPH_CLK_CLB4      = false;
sysctl.enable_SYSCTL_PERIPH_CLK_FSITXA    = false;
sysctl.enable_SYSCTL_PERIPH_CLK_LINA      = false;
sysctl.enable_SYSCTL_PERIPH_CLK_FSIRXA    = false;
sysctl.enable_SYSCTL_PERIPH_CLK_PMBUSA    = false;
sysctl.enable_SYSCTL_PERIPH_CLK_DACB      = false;
sysctl.enable_SYSCTL_PERIPH_CLK_DACA      = false;
sysctl.enable_SYSCTL_PERIPH_CLK_CLA1      = false;

/**
 * Pinmux solution for unlocked pins/peripherals. This ensures that minor changes to the automatic solver in a future
 * version of the tool will not impact the pinmux you originally saw.  These lines can be completely deleted in order to
 * re-solve from scratch.
 */
aio1.aioPin.$suggestSolution          = "AIO231";
aio2.aioPin.$suggestSolution          = "AIO241";
aio3.aioPin.$suggestSolution          = "AIO237";
aio4.aioPin.$suggestSolution          = "AIO232";
aio5.aioPin.$suggestSolution          = "AIO230";
aio6.aioPin.$suggestSolution          = "AIO238";
epwm1.epwm.$suggestSolution           = "EPWM1";
epwm1.epwm.epwm_aPin.$suggestSolution = "boosterpack2.80";
epwm1.epwm.epwm_bPin.$suggestSolution = "boosterpack2.79";
epwm2.epwm.$suggestSolution           = "EPWM2";
epwm2.epwm.epwm_aPin.$suggestSolution = "boosterpack2.76";
epwm2.epwm.epwm_bPin.$suggestSolution = "boosterpack2.75";
epwm3.epwm.$suggestSolution           = "EPWM3";
epwm3.epwm.epwm_aPin.$suggestSolution = "boosterpack1.36";
epwm3.epwm.epwm_bPin.$suggestSolution = "boosterpack1.35";
gpio3.gpioPin.$suggestSolution        = "boosterpack1.34";
gpio4.gpioPin.$suggestSolution        = "boosterpack1.32";
gpio5.gpioPin.$suggestSolution        = "boosterpack1.33";
sci1.sci.$suggestSolution             = "SCIA";
sci1.sci.sci_rxPin.$suggestSolution   = "boosterpack2.43";
sci1.sci.sci_txPin.$suggestSolution   = "boosterpack2.44";
sci2.sci.$suggestSolution             = "SCIB";
sci2.sci.sci_rxPin.$suggestSolution   = "boosterpack1.3";
sci2.sci.sci_txPin.$suggestSolution   = "boosterpack1.4";
spi1.spi.spi_simoPin.$suggestSolution = "boosterpack1.15";
spi1.spi.spi_somiPin.$suggestSolution = "boosterpack1.14";
spi1.spi.spi_clkPin.$suggestSolution  = "boosterpack1.7";
spi1.spi.spi_stePin.$suggestSolution  = "boosterpack1.19";
spi2.spi.$suggestSolution             = "SPIB";
spi2.spi.spi_simoPin.$suggestSolution = "boosterpack2.55";
spi2.spi.spi_somiPin.$suggestSolution = "boosterpack2.54";
spi2.spi.spi_clkPin.$suggestSolution  = "boosterpack2.47";
spi2.spi.spi_stePin.$suggestSolution  = "boosterpack2.59";
