/**
 * @cliArgs --board "/LAUNCHXL_F280049C" --context "system" --product "C2000WARE@4.02.00.00"
 * @versions {"tool":"1.14.0+2667"}
 */

/**
 * Import the modules used in this configuration.
 */
const gpio  = scripting.addModule("/driverlib/gpio.js", {}, false);
const gpio1 = gpio.addInstance();
const gpio2 = gpio.addInstance();
const sci   = scripting.addModule("/driverlib/sci.js", {}, false);
const sci1  = sci.addInstance();

/**
 * Write custom configuration values to the imported modules.
 */
gpio1.direction         = "GPIO_DIR_MODE_OUT";
gpio1.writeInitialValue = true;
gpio1.initialValue      = 1;
gpio1.$name             = "ILI9341_GPIO_CS";
gpio1.gpioPin.$assign   = "boosterpack1.39";
scripting.suppress("Connected to hardware,@@@.+?@@@ is connected to EPWM6 BP on the LaunchPad F280049C\\. Consider selecting it in 'use hardware' above\\. @@@.+?@@@", gpio1, "gpioPin");

gpio2.direction         = "GPIO_DIR_MODE_OUT";
gpio2.writeInitialValue = true;
gpio2.$name             = "ILI9341_GPIO_DCX";
gpio2.gpioPin.$assign   = "boosterpack1.13";

sci1.$hardware             = system.deviceData.board.components.XDS_UART.subComponents.XDS_SCI_INST1;
sci1.enabledFIFOInterrupts = ["SCI_INT_RXFF"];
sci1.rxFifo                = "SCI_FIFO_RX1";
sci1.$name                 = "DATA_LOG_UART";

/**
 * Pinmux solution for unlocked pins/peripherals. This ensures that minor changes to the automatic solver in a future
 * version of the tool will not impact the pinmux you originally saw.  These lines can be completely deleted in order to
 * re-solve from scratch.
 */
sci1.sci.$suggestSolution           = "SCIA";
sci1.sci.sci_rxPin.$suggestSolution = "boosterpack2.43";
sci1.sci.sci_txPin.$suggestSolution = "boosterpack2.44";
